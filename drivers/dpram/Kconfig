## drivers/dpram/Kconfig
```kconfig
#
# dpram subsystem configuration
#

menu "DPRAM"

config DPRAM
	tristate "Samsung dpram module"
	default y
	help
		dpram

endmenu
```

## drivers/vibetonz/Kconfig
```kconfig
#
# Vibrator subsystem configuration
#

menu "Vibrator"

config VIBETONZ
	tristate "Samsung vibrator module"
	default y
	help
		vibetonz

endmenu
```
